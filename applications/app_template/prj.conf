## CMakeLists.txt
```
cmake_minimum_required(VERSION 3.13.1)

find_package(Zephyr REQUIRED HINTS $ENV{ZEPHYR_BASE})
project(app_template)

target_sources(app PRIVATE
	src/main.c
	src/other.c)
target_include_directories(app PRIVATE include)
```

## prj.conf
```kconfig
# Config logger
CONFIG_LOG=y
CONFIG_USE_SEGGER_RTT=y
CONFIG_LOG_BACKEND_RTT=y
CONFIG_LOG_BACKEND_UART=n
```

## src/main.c
```c
/** @file
 *  @brief Application template
 */

/** Other files */

/** Functions */
void main(void) {
	int err;

	printk("Initializing...\n");

	if (err) {
		printk("Bluetooth init failed (err %d)\n", err);
	}
}
```

## include/other.h
```c
/**
 * @file
 * @brief Header file
 */

#ifndef OTHER_H__
#define OTHER_H__

/** Includes */

#ifdef __cplusplus
extern "C" {
#endif


/** Content of header file */


#ifdef __cplusplus
}
#endif

#endif /* MODEL_HANDLER_H__ */
```
