## Kconfig.prjtemp
```kconfig
menu "Project Template"

rsource "subsys/Kconfig"
rsource "drivers/Kconfig"

endmenu
```

## west.yml
```yaml
manifest:
# West-related configuration for the ncs_project_template repository.
  self:
    path: my_projects/ncs_project_template
```
